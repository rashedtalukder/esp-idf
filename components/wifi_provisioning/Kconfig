## components/wifi_provisioning/Kconfig
```kconfig
menu "Wi-Fi Provisioning Manager"

    config WIFI_PROV_SCAN_MAX_ENTRIES
        int "Max Wi-Fi Scan Result Entries"
        default 16
        range 1 255
        help
            This sets the maximum number of entries of Wi-Fi scan results that will be kept by the provisioning manager

    config WIFI_PROV_AUTOSTOP_TIMEOUT
        int "Provisioning auto-stop timeout"
        default 30
        range 5 600
        help
            Time (in seconds) after which the Wi-Fi provisioning manager will auto-stop after connecting to
            a Wi-Fi network successfully.

    config WIFI_PROV_BLE_BONDING
        bool
        default n
        prompt "Enable BLE bonding"
        depends on BT_ENABLED
        help
            This option is applicable only when provisioning transport is BLE.

    menu "WPA2 Enterprise Support"

        config WIFI_PROV_WPA2_ENTERPRISE_SUPPORT
            bool "Support for WPA2 Enterprise APs"
            default n
            help
                Enable provisioning support for WPA2 Enterprise APs

                Note: Currently, only PEAP is supported as EAP Method.

        choice
            depends on WIFI_PROV_WPA2_ENTERPRISE_SUPPORT
            prompt "EAP method to use"
            default  WIFI_PROV_WPA2_ENT_EAP_METHOD_PEAP
            config  WIFI_PROV_WPA2_ENT_EAP_METHOD_PEAP
                bool "PEAP"
        endchoice

        config  WIFI_PROV_WPA2_ENT_EAP_METHOD
            int
            default 0 if  WIFI_PROV_WPA2_ENT_EAP_METHOD_PEAP

    endmenu

endmenu
```

## examples/provisioning/wifi_prov_mgr/main/Kconfig.projbuild
```kconfig
menu "Example Configuration"

    choice EXAMPLE_PROV_TRANSPORT
        bool "Provisioning Transport"
        default EXAMPLE_PROV_TRANSPORT_SOFTAP if IDF_TARGET_ESP32S2
        default EXAMPLE_PROV_TRANSPORT_BLE
        help
            Wi-Fi provisioning component offers both, SoftAP and BLE transports. Choose any one.

        config EXAMPLE_PROV_TRANSPORT_BLE
            bool "BLE"
            select BT_ENABLED
            depends on !IDF_TARGET_ESP32S2
        config EXAMPLE_PROV_TRANSPORT_SOFTAP
            bool "Soft AP"
    endchoice

    config EXAMPLE_PROV_TRANSPORT
        int
        default 1 if EXAMPLE_PROV_TRANSPORT_BLE
        default 2 if EXAMPLE_PROV_TRANSPORT_SOFTAP

    config EXAMPLE_RESET_PROVISIONED
        bool
        default n
        prompt "Reset provisioned status of the device"
        help
            This erases the NVS to reset provisioned status of the device on every reboot.
            Provisioned status is determined by the Wi-Fi STA configuration, saved on the NVS.

    config EXAMPLE_RESET_PROV_MGR_ON_FAILURE
        bool
        default y
        prompt "Reset provisioned credentials and state machine after session failure"
        help
            Enable reseting provisioned credentials and state machine after session failure.
            This will restart the provisioning service after retries are exhausted.

    config EXAMPLE_PROV_MGR_MAX_RETRY_CNT
        int
        default 5
        prompt "Max retries before reseting provisioning state machine"
        depends on EXAMPLE_RESET_PROV_MGR_ON_FAILURE
        help
            Set the Maximum retry to avoid reconnecting to an inexistent AP or if credentials
            are misconfigured. Provisioned credentials are erased and internal state machine
            is reset after this threshold is reached.

    config EXAMPLE_PROV_SHOW_QR
        bool "Show provisioning QR code"
        default y
        help
            Show the QR code for provisioning.

    config EXAMPLE_PROV_USING_BLUEDROID
        bool
        depends on (BT_BLUEDROID_ENABLED && (IDF_TARGET_ESP32C3 || IDF_TARGET_ESP32S3))
        select BT_BLE_42_FEATURES_SUPPORTED
        default y
        help
            This enables BLE 4.2 features for Bluedroid.

    menu "Provisioning: WPA2 Enterprise AP Support"
        depends on WIFI_PROV_WPA2_ENTERPRISE_SUPPORT

        config EXAMPLE_PROV_WPA2_ENT_EAP_ID
            string "WPA2 Enterprise: EAP Outer Identity"
            default "example@email.com"
            help
                Identity in phase 1 of EAP procedure.

        config EXAMPLE_PROV_WPA2_ENT_VALIDATE_SERVER
            bool "Validate WPA2 Enterprise server"
            default y
            help
                Validate the WPA2 Enterprise servers' certificate using CA cert.

        config EXAMPLE_PROV_WPA2_ENT_CERT_BUNDLE
            bool "Use default cert bundle for server validation"
            default y
            depends on EXAMPLE_PROV_WPA2_ENT_VALIDATE_SERVER
            help
                Use cert from CA certificate bundle for WPA2 enterprise connection server validation

                Note: In rare cases, the WPA2 Enterprise server's CA cert maybe not present in the
                default bundle. Thus, the bundle will have to be extended using the following config
                options - MBEDTLS_CUSTOM_CERTIFICATE_BUNDLE and MBEDTLS_CUSTOM_CERTIFICATE_BUNDLE_PATH.

    endmenu

endmenu
```
